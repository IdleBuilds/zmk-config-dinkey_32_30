## config/boards/shields/dinkey_32_30/Kconfig.defconfig
```kconfig
# Copyright (c) 2023 Idle Builds
# SPDX-License-Identifier: MIT

if SHIELD_DINKEY_32_30_LEFT

config ZMK_KEYBOARD_NAME
    default "Dinkey 32|30"

config ZMK_SPLIT_ROLE_CENTRAL
    default y

endif # SHIELD_DINKEY_32_30_LEFT

if SHIELD_DINKEY_32_30_LEFT || SHIELD_DINKEY_32_30_RIGHT

config ZMK_SPLIT
    default y

endif # SHIELD_DINKEY_32_30_LEFT || SHIELD_DINKEY_32_30_RIGHT
```

## config/boards/shields/dinkey_32_30/Kconfig.shield
```kconfig
# Copyright (c) 2023 Idle Builds
# SPDX-License-Identifier: MIT

config SHIELD_DINKEY_32_30
    bool

config SHIELD_DINKEY_32_30_LEFT
    def_bool $(shields_list_contains,dinkey_32_30_left)
    select SHIELD_DINKEY_32_30

config SHIELD_DINKEY_32_30_RIGHT
    def_bool $(shields_list_contains,dinkey_32_30_right)
    select SHIELD_DINKEY_32_30
```
